## configs/orangepi_5_defconfig
```kconfig
BR2_aarch64=y
BR2_cortex_a76_a55=y
BR2_KERNEL_HEADERS_CUSTOM_GIT=y
BR2_KERNEL_HEADERS_CUSTOM_REPO_URL="https://github.com/orangepi-xunlong/linux-orangepi.git"
BR2_KERNEL_HEADERS_CUSTOM_REPO_VERSION="orange-pi-5.10-rk3588"
BR2_PACKAGE_HOST_LINUX_HEADERS_CUSTOM_5_10=y
BR2_BINUTILS_VERSION_2_39_X=y
BR2_GCC_VERSION_12_X=y
BR2_TOOLCHAIN_BUILDROOT_CXX=y
BR2_GCC_ENABLE_OPENMP=y
BR2_GCC_ENABLE_GRAPHITE=y
BR2_PACKAGE_HOST_GDB=y
BR2_PACKAGE_HOST_GDB_TUI=y
BR2_PACKAGE_HOST_GDB_PYTHON3=y
BR2_GDB_VERSION_12=y
BR2_TOOLCHAIN_EXTRA_LIBS="libasan liblsan libtsan libubsan"
BR2_ENABLE_DEBUG=y
BR2_DEBUG_3=y
BR2_ENABLE_LTO=y
BR2_GLOBAL_PATCH_DIR="board/orangepi/orangepi-5/patches"
BR2_FORTIFY_SOURCE_2=y
BR2_TARGET_GENERIC_HOSTNAME="orangepi-5"
BR2_TARGET_GENERIC_ISSUE="Welcome to orangepi-5"
BR2_ROOTFS_MERGED_USR=y
BR2_TARGET_GENERIC_ROOT_PASSWD="orangepi-5"
BR2_TARGET_GENERIC_GETTY_TERM="linux"
BR2_SYSTEM_DHCP="eth0"
BR2_ROOTFS_OVERLAY="board/orangepi/orangepi-5/overlays"
BR2_ROOTFS_POST_IMAGE_SCRIPT="board/orangepi/orangepi-5/post-image.sh"
BR2_LINUX_KERNEL=y
BR2_LINUX_KERNEL_CUSTOM_GIT=y
BR2_LINUX_KERNEL_CUSTOM_REPO_URL="https://github.com/orangepi-xunlong/linux-orangepi.git"
BR2_LINUX_KERNEL_CUSTOM_REPO_VERSION="orange-pi-5.10-rk3588"
BR2_LINUX_KERNEL_USE_CUSTOM_CONFIG=y
BR2_LINUX_KERNEL_CUSTOM_CONFIG_FILE="board/orangepi/orangepi-5/linux.config"
BR2_LINUX_KERNEL_ZSTD=y
BR2_LINUX_KERNEL_DTS_SUPPORT=y
BR2_LINUX_KERNEL_INTREE_DTS_NAME="rockchip/rk3588s-orangepi-5"
BR2_LINUX_KERNEL_DTB_OVERLAY_SUPPORT=y
BR2_PACKAGE_BUSYBOX_CONFIG="board/orangepi/orangepi-5/busybox.config"
BR2_TARGET_ROOTFS_EXT2=y
BR2_TARGET_ROOTFS_EXT2_4=y
BR2_TARGET_ROOTFS_EXT2_SIZE="150M"
BR2_TARGET_ROOTFS_TAR_ZSTD=y
BR2_TARGET_UBOOT=y
BR2_TARGET_UBOOT_BUILD_SYSTEM_KCONFIG=y
BR2_TARGET_UBOOT_CUSTOM_TARBALL=y
BR2_TARGET_UBOOT_CUSTOM_TARBALL_LOCATION="$(call github,smsxgli,u-boot,019261632bf5ea93b8faa7571382b460f673a5cd)/u-boot-019261632bf5ea93b8faa7571382b460f673a5cd.tar.gz"
BR2_TARGET_UBOOT_BOARD_DEFCONFIG="orangepi_5"
BR2_TARGET_UBOOT_NEEDS_DTC=y
BR2_TARGET_UBOOT_NEEDS_PYTHON3=y
BR2_TARGET_UBOOT_NEEDS_OPENSSL=y
BR2_TARGET_UBOOT_NEEDS_XXD=y
# BR2_TARGET_UBOOT_FORMAT_BIN is not set
BR2_TARGET_UBOOT_FORMAT_ITB=y
BR2_TARGET_UBOOT_SPL=y
BR2_TARGET_UBOOT_SPL_NAME="spl/u-boot-spl.bin tpl/u-boot-tpl.bin"
BR2_TARGET_UBOOT_CUSTOM_MAKEOPTS="BL31=${CONFIG_DIR}/board/orangepi/orangepi-5/rkbin/bin/rk35/rk3588_bl31_v1.38.elf BL32=${CONFIG_DIR}/board/orangepi/orangepi-5/rkbin/bin/rk35/rk3588_bl32_v1.13.bin"
BR2_PACKAGE_HOST_ENVIRONMENT_SETUP=y
BR2_PACKAGE_HOST_GENIMAGE=y
BR2_PACKAGE_HOST_MTOOLS=y
BR2_PACKAGE_HOST_UBOOT_TOOLS=y
```

## package/rockchip/Config.in
```kconfig
menuconfig BR2_PACKAGE_ROCKCHIP
	bool "Rockchip Platform"

if BR2_PACKAGE_ROCKCHIP

config BR2_PACKAGE_ROCKCHIP_HAS_ISP1
	bool
	help
	  Has Rockchip ISP1

config BR2_PACKAGE_ROCKCHIP_HAS_ISP2
	bool
	help
	  Has Rockchip ISP2

config BR2_PACKAGE_ROCKCHIP_HAS_ISP3
	bool
	help
	  Has Rockchip ISP3

choice
	default BR2_PACKAGE_RK3588
	prompt "Rockchip SoC"

config BR2_PACKAGE_PX30
	bool "px30 chip"
	select BR2_PACKAGE_ROCKCHIP_HAS_ISP1
	help
	  Use rockchip's px30 chip

config BR2_PACKAGE_RK3036
	bool "rk3036 chip"
	help
	  Use rockchip's rk3036 chip

config BR2_PACKAGE_RK312X
	bool "rk312x chip"
	select BR2_PACKAGE_ROCKCHIP_HAS_ISP1
	help
	  Use rockchip's rk312x chip

config BR2_PACKAGE_RK3288
	bool "rk3288 chip"
	select BR2_PACKAGE_ROCKCHIP_HAS_ISP1
	help
	  Use rockchip's rk3288 chip

config BR2_PACKAGE_RK3308
	bool "rk3308 chip"
	help
	  Use rockchip's rk3308 chip

config BR2_PACKAGE_RK3326
	bool "rk3326 chip"
	select BR2_PACKAGE_ROCKCHIP_HAS_ISP1
	help
	  Use rockchip's rk3326 chip

config BR2_PACKAGE_RK3358
	bool "rk3358 chip"
	select BR2_PACKAGE_ROCKCHIP_HAS_ISP1
	help
	  Use rockchip's rk3358 chip

config BR2_PACKAGE_RK3399
	bool "rk3399 chip"
	select BR2_PACKAGE_ROCKCHIP_HAS_ISP1
	help
	  Use Rockchip's rk3399 SoC

config BR2_PACKAGE_RK3399PRO
	bool "rk3399pro chip"
	select BR2_PACKAGE_ROCKCHIP_HAS_ISP1
	help
	  Use Rockchip's rk3399pro SoC

config BR2_PACKAGE_RK3528
	bool "rk3528 chip"
	help
	  Use Rockchip's rk3528 SoC

config BR2_PACKAGE_RK3562
	bool "rk3562 chip"
	select BR2_PACKAGE_ROCKCHIP_HAS_ISP2
	help
	  Use Rockchip's rk3562 SoC

config BR2_PACKAGE_RK3566_RK3568
	bool "rk3566 or rk3568 chip"
	select BR2_PACKAGE_ROCKCHIP_HAS_ISP2
	help
	  Use Rockchip's rk3566 or rk3568 SoC

config BR2_PACKAGE_RK3588
	bool "rk3588"
	select BR2_PACKAGE_ROCKCHIP_HAS_ISP3
	help
	  Use Rockchip's rk3588 SoC

endchoice

# Camera Engine packages
config BR2_PACKAGE_CAMERA_ENGINE
	bool "Rockchip Camera Engine For ISP"
	depends on BR2_PACKAGE_ROCKCHIP_HAS_ISP1 || BR2_PACKAGE_ROCKCHIP_HAS_ISP2 || BR2_PACKAGE_ROCKCHIP_HAS_ISP3
	select BR2_PACKAGE_CAMERA_ENGINE_RKISP if BR2_PACKAGE_ROCKCHIP_HAS_ISP1
	select BR2_PACKAGE_CAMERA_ENGINE_RKAIQ if BR2_PACKAGE_ROCKCHIP_HAS_ISP2
	select BR2_PACKAGE_CAMERA_ENGINE_RKAIQ if BR2_PACKAGE_ROCKCHIP_HAS_ISP3
	help
	  Depend on Chip Type, there are different camera_engine packages.
	  Enable this config to choose camera_engine package by chip automatically.

config BR2_PACKAGE_ROCKCHIP_SDK_VERSION
	string "Rockchip SDK version"
	default rk3588/linux_release_v1.1.1a
	help
		Rockchip SDK version, tag of firefly gitlab repository

menu "Rockchip BSP packages"
	source "package/rockchip/camera-engine-rkaiq/Config.in"
	source "package/rockchip/camera-engine-rkisp/Config.in"
	source "package/rockchip/rockchip-mpp/Config.in"
	source "package/rockchip/rockchip-rga/Config.in"
	source "package/rockchip/rkwifibt/Config.in"
endmenu

endif
```
